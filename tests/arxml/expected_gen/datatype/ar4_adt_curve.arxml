AUTOSAR XML (schema 4-2-2)
standard types defined: boolean, uint8, uint16, uint32, boolean_DataConstr, uint8_DataConstr, uint16_DataConstr, uint32_DataConstr, float32
package /DataTypes
  app type ADT_Com_axis: category=COM_AXIS, sw-calprm-axis-set={sw-axis-index=1, sw-axis-individual={compu {identical}, unit=NoUnit, sw-max-axis-points=60, sw-min-axis-points=50, range phys -3..3}}
  app type ADT_Curve: category=CURVE, sw-calibration-access=READ-ONLY, sw-calprm-axis-set={sw-axis-index=1, category=COM_AXIS, sw-axis-grouped={shared-axis-type=ADT_Com_axis, sw-axis-index=1}}, compu {identical}, range phys -3..3
package /DataTypes/Units
  unit NoUnit: display-name=NoUnit
