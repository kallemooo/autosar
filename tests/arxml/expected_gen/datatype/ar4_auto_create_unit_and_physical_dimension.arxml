AUTOSAR XML (schema 4-2-2)
standard types defined: boolean, uint8, uint16, uint32, boolean_DataConstr, uint8_DataConstr, uint16_DataConstr, uint32_DataConstr, float32
package /DataTypes
  impl type TestType_T: compu {phys=raw/64 for raw 0..65535; unit TestUnit}, range raw 0..65535, implementation-data-type=uint16, unit=TestUnit
package /DataTypes/Units
  unit TestUnit: display-name=TestUnit, physical-dimension=TestDim
  physical dimension TestDim: length-exp=10, mass-exp=11, time-exp=NaN, current-exp=-INF, temperature-exp=INF, molar-amount-exp=-293.112, luminous-intensity-exp=341.333
